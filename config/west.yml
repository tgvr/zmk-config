## config/west.yml
```yaml
manifest:
  remotes:
    - name: zmkfirmware
      url-base: https://github.com/zmkfirmware
    - name: 280Zo
      url-base: https://github.com/280Zo
    - name: urob
      url-base: https://github.com/urob

  projects:
    - name: zmk
      remote: zmkfirmware
      revision: v0.3
      import: app/west.yml
    - name: zmk-pmw3610-driver
      remote: 280Zo
      revision: main

    # urob's ZMK modules
    - name: zmk-adaptive-key
      remote: urob
      path: modules/zmk/adaptive-key
      revision: v0.3
    - name: zmk-auto-layer
      remote: urob
      path: modules/zmk/auto-layer
      revision: v0.3
    - name: zmk-helpers
      remote: urob
      path: modules/zmk/helpers
      revision: v0.3
    - name: zmk-leader-key
      remote: urob
      path: modules/zmk/leader-key
      revision: v0.3
    - name: zmk-tri-state
      remote: urob
      path: modules/zmk/tri-state
      revision: v0.3
    - name: zmk-unicode
      remote: urob
      path: modules/zmk/unicode
      revision: v0.3

  self:
    path: config
```
