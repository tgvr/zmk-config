/*                KEY POSITIONS

  ╭─────────────────────╮ ╭─────────────────────╮
  │ LT4 LT3 LT2 LT1 LT0 │ │ RT0 RT1 RT2 RT3 RT4 │
  │ LM4 LM3 LM2 LM1 LM0 │ │ RM0 RM1 RM2 RM3 RM4 │
  │ LB4 LB3 LB2 LB1 LB0 │ │ RB0 RB1 RB2 RB3 RB4 │
  ╰───────╮ LH2 LH1 LH0 │ │ RH0 RH1 ╭───────────╯
          ╰─────────────╯ ╰─────────╯ */

#include "layers.h"

#define COMBO_TERM_FAST 18
#define COMBO_TERM_SLOW 30

#define COMBO_IDLE_FAST 150
#define COMBO_IDLE_SLOW 50

// // Combos overlapping HRMs are set up as hold-taps themselves to allow for instantaneous
// // chording of mods. Custom hold-tap instances can be bootstrapped on the go using the
// // 8-argument version of ZMK_COMBO defined in base.keymap.
// ZMK_COMBO(tab0,   &hml LS(LALT)TAB, LM3 LM2, BASE NAV NUM, COMBO_TERM_FAST, COMBO_IDLE_FAST)
// ZMK_COMBO(ldr,   &leader,      LM2 LM1,     BASE NAV NUM, COMBO_TERM_FAST, COMBO_IDLE_FAST, LS(LCTRL),    KEYS_R)
// ZMK_COMBO(ldrsh, &leader_sft,  LM3 LM2 LM1, BASE NAV NUM, COMBO_TERM_FAST, COMBO_IDLE_FAST, LS(LC(LALT)), KEYS_R)

ZMK_COMBO(tab,   &kp TAB,      LT2 LT1,         BASE LOWER NUM RAISE ADJUST MEDIA MOUSE SLOW SCROLL, COMBO_TERM_FAST, COMBO_IDLE_FAST)
ZMK_COMBO(mclk,  &mkp MCLK,    RB1 RB2,         BASE LOWER NUM RAISE ADJUST MEDIA MOUSE SLOW SCROLL, COMBO_TERM_FAST, COMBO_IDLE_FAST)
