#include <behaviors.dtsi>
#include <behaviors/num_word.dtsi> // Requires zmk-auto-layer module.
#include <behaviors/unicode.dtsi> // Requires zmk-unicode module.
#include <behaviors/mouse_keys.dtsi>
#include <zmk-helpers/helper.h> // Requires zmk-helpers module.
#include <dt-bindings/zmk/keys.h>
#include <dt-bindings/zmk/bt.h>
#include <dt-bindings/zmk/outputs.h>
#include <dt-bindings/zmk/mouse.h>

#include "layers.h"

#define XXX &none
#define ___ &trans

/* Global defaults */

#define QUICK_TAP_MS 175

&sk {
  // release-after-ms = <900>;
  quick-release;
};

&sl { // Allow sticky mods to chord across sticky layers.
  ignore-modifiers;
};

&lt {
  flavor = "balanced";
  tapping-term-ms = <280>;
  quick-tap-ms = <QUICK_TAP_MS>;
};

&uc {
  default-mode = <UC_MODE_MACOS>;
  minimum-length = <0>;            // Set to desired minimum input length
};


/* Homerow mods */

#define KEYS_L LT0 LT1 LT2 LT3 LT4 LM0 LM1 LM2 LM3 LM4 LB0 LB1 LB2 LB3 LB4
#define KEYS_R RT0 RT1 RT2 RT3 RT4 RM0 RM1 RM2 RM3 RM4 RB0 RB1 RB2 RB3 RB4
#define THUMBS LH2 LH1 LH0 RH0 RH1 // Thumbs on Charybdis Mini

#define MAKE_HRM(NAME, HOLD, TAP, TRIGGER_POS)                                 \
  ZMK_HOLD_TAP(NAME, bindings = <HOLD>, <TAP>; flavor = "balanced";            \
               tapping-term-ms = <280>; quick-tap-ms = <QUICK_TAP_MS>;         \
               require-prior-idle-ms = <150>; hold-trigger-on-release;         \
               hold-trigger-key-positions = <TRIGGER_POS>;)

MAKE_HRM(hml, &kp, &kp, KEYS_R THUMBS) // Left-hand HRMs.
MAKE_HRM(hmr, &kp, &kp, KEYS_L THUMBS) // Right-hand HRMs.

// Hack: Make HRM combos tap-only (cf, ZMK issue #544).
#define ZMK_COMBO_8(NAME, TAP, POS, LAYERS, COMBO_MS, IDLE_MS, HOLD, SIDE)     \
  MAKE_HRM(hm_combo_##NAME, &kp, TAP, SIDE THUMBS)                             \
  ZMK_COMBO_6(NAME, &hm_combo_##NAME HOLD 0, POS, LAYERS, COMBO_MS, IDLE_MS)

ZMK_HOLD_TAP(hmod, bindings = <&kp &sk>;                                        \
             flavor = "hold-preferred"; tapping-term-ms = <200>;)

#define HMOD(mod) &hmod mod mod

/* Combos, leader key sequences, mouse emulation */

#include "combos.dtsi" // Must be sourced after HRM-combo hack.

/* Magic-shift & auto-layers */

// Tap: repeat after alpha, else sticky-shift |
// Shift + tap/ double-tap: caps-word | Hold: shift.
#define MAGIC_SHIFT &magic_shift LSHFT 0
ZMK_HOLD_TAP(magic_shift, bindings = <&kp>, <&magic_shift_tap>;
             flavor = "balanced"; tapping-term-ms = <200>;
             quick-tap-ms = <QUICK_TAP_MS>;)
ZMK_MOD_MORPH(magic_shift_tap, bindings = <&shift_repeat>, <&caps_word>;
              mods = <(MOD_LSFT)>;)
ZMK_ADAPTIVE_KEY(
    shift_repeat, bindings = <&sk LSHFT>;
    repeat {
      trigger-keys = <A B C D E F G H I J K L M N O P Q R S T U V W X Y Z>;
      bindings = <&key_repeat>;
      max-prior-idle-ms = <1200>;
      strict-modifiers;
    };)
&caps_word { // Mods deactivate caps-word, requires PR #1451. [TODO: rebase]
  /delete-property/ ignore-modifiers;
};

// Tap: num-word | double-tap: sticky num-layer | Hold: num-layer.
#define SMART_NUM &smart_num NUM 0
ZMK_HOLD_TAP(smart_num, bindings = <&mo>, <&num_dance>; flavor = "balanced";
             tapping-term-ms = <200>; quick-tap-ms = <QUICK_TAP_MS>;)
ZMK_TAP_DANCE(num_dance, bindings = <&num_word NUM>, <&sl NUM>;
              tapping-term-ms = <200>;)

/* Custom behaviors */

// Define mod-morph with a *single* mod trigger for less repetition.
#define SIMPLE_MORPH(NAME, MOD, BINDING1, BINDING2)                            \
  ZMK_MOD_MORPH(NAME, mods = <(MOD_L##MOD | MOD_R##MOD)>;                      \
                bindings = <BINDING1>, <BINDING2>;)

// // Tap: comma | Shift + tap: semicolon | Ctrl + shift + tap: <.
// SIMPLE_MORPH(comma_morph, SFT, &kp COMMA, &comma_inner_morph)
// SIMPLE_MORPH(comma_inner_morph, CTL, &kp SEMICOLON, &kp LESS_THAN)

SIMPLE_MORPH(mm_eq_pl, SFT, &kp EQUAL, &kp PLUS)
SIMPLE_MORPH(mm_min_under, SFT, &kp MINUS, &kp UNDER)
SIMPLE_MORPH(mm_under_min, SFT, &kp UNDER, &kp MINUS)
SIMPLE_MORPH(mm_sqt_dqt, SFT, &kp SQT, &kp DQT)
SIMPLE_MORPH(mm_cm_lt, SFT, &kp COMMA, &kp LT)
SIMPLE_MORPH(mm_prd_gt, SFT, &kp PERIOD, &kp GT)
SIMPLE_MORPH(mm_sc_co, SFT, &kp SEMICOLON, &kp COLON)
SIMPLE_MORPH(mm_fslh_qm, SFT, &kp FSLH, &kp QUESTION)

SIMPLE_MORPH(mm_n1_f1, SFT, &kp N1, &kp F1)
SIMPLE_MORPH(mm_n2_f2, SFT, &kp N2, &kp F2)
SIMPLE_MORPH(mm_n3_f3, SFT, &kp N3, &kp F3)
SIMPLE_MORPH(mm_n4_f4, SFT, &kp N4, &kp F4)
SIMPLE_MORPH(mm_n5_f5, SFT, &kp N5, &kp F5)
SIMPLE_MORPH(mm_n6_f6, SFT, &kp N6, &kp F6)
SIMPLE_MORPH(mm_n7_f7, SFT, &kp N7, &kp F7)
SIMPLE_MORPH(mm_n8_f8, SFT, &kp N8, &kp F8)
SIMPLE_MORPH(mm_n9_f9, SFT, &kp N9, &kp F9)
SIMPLE_MORPH(mm_dv_f10, SFT, &kp FSLH, &kp F10)
SIMPLE_MORPH(mm_min_f11, SFT, &kp MINUS, &kp F11)
SIMPLE_MORPH(mm_prd_f12, SFT, &kp PERIOD, &kp F12)


// Tap: space | Shift + tap: dot -> space -> sticky shift | Hold: nav layer.
ZMK_HOLD_TAP(lt_spc, bindings = <&mo>, <&spc_morph>; flavor = "balanced";
             tapping-term-ms = <200>; quick-tap-ms = <QUICK_TAP_MS>;)
SIMPLE_MORPH(spc_morph, SFT, &kp SPACE, &dot_spc)
ZMK_MACRO(dot_spc, bindings = <&kp DOT &kp SPACE &sk LSHFT>; wait-ms = <0>;
          tap-ms = <5>;)

// Tap: BSPC | Hold: Trackball Scroll layer | tap once and then hold: Trackball Snipe layer
// ZMK_TAP_DANCE(td_bs_scrl_slow, bindings = <&lt SCROLL BSPC>, <&mo SLOW>;
//               tapping-term-ms = <200>;)

// // Sticky shift + leader.
// ZMK_MACRO(leader_sft, bindings = <&sk LSHFT &leader>;)

/* Macros and defines */
#define LOCK_SCREEN     &kp LG(LC(Q))   // Pin window across desktops.
#define B_CUT             &kp LG(X)
#define B_COPY            &kp LG(C)
#define B_PASTE           &kp LG(V)
#define DICTATION         &kp LG(LCTRL)
#define SCROLL_BS         &lt SCROLL BSPC
#define LOWER_SPACE       &lt LOWER SPACE
#define RAISE_R           &lt RAISE R

/* Keymap */

#ifndef ZMK_BASE_LAYER
  #define ZMK_BASE_LAYER(name, LT, RT, LM, RM, LB, RB, LH, RH)                 \
      ZMK_LAYER(name, LT RT LM RM LB RB LH RH)
#endif



ZMK_BASE_LAYER(Base,
    XXX     &kp Q           &kp Y           &kp O           &kp U           &mm_min_under   ,   &kp X       &kp L           &kp D           &kp P           &kp Z           XXX         ,
    &kp B   &hml LCTRL C    &hml LSHFT I    &hml LALT A     &hml LGUI E     &mm_eq_pl       ,   &kp K       &hmr RGUI H     &hmr RALT T     &hmr RSHFT N    &hmr RCTRL S    &kp W       ,
    XXX     &mm_sqt_dqt     &mm_sc_co       &mm_cm_lt       &mm_prd_gt      &mm_fslh_qm     ,   &kp J       &kp M           &kp G           &kp F           &kp V           &tog MEDIA  ,
                                            SCROLL_BS       LOWER_SPACE     SMART_NUM       ,   DICTATION   RAISE_R
)

ZMK_BASE_LAYER(Lower,
    ___ &kp HOME    &kp PIPE    &kp LBRC    &kp RBRC    ___ ,   ___ &kp PG_UP   &kp UP      ___         ___     ___         ,
    ___ &kp LCTRL   &kp LSHFT   &kp LALT    &kp LGUI    ___ ,   ___ &kp LEFT    &kp DOWN    &kp RIGHT   &kp TAB ___         ,
    ___ &kp END     &kp PRCNT   &kp SQT     &kp DQT     ___ ,   ___ &kp PG_DN   &kp TILDE   &kp GRAVE   ___     &tog LOWER  ,
                                ___         ___         ___ ,   ___ &kp ENTER
)

/* todo: num layer needs math symbols +/-*^%!()<>,. */
ZMK_BASE_LAYER(Num,
    ___ ___         ___         ___         ___         ___ ,   ___         &mm_n7_f7   &mm_n8_f8   &mm_n9_f9   &mm_dv_f10      ___         ,
    ___ &kp LCTRL   &kp LSHFT   &kp LALT    &kp LGUI    ___ ,   ___         &mm_n4_f4   &mm_n5_f5   &mm_n6_f6   &mm_min_f11     ___         ,
    ___ ___         ___         ___         ___         ___ ,   &kp N0      &mm_n1_f1   &mm_n2_f2   &mm_n3_f3   &mm_prd_f12     &tog NUM    ,
                                ___         ___         ___ ,   &mo ADJUST  ___
)

ZMK_BASE_LAYER(Raise,
    ___ ___ &kp AMPS    &kp LPAR    &kp RPAR    ___ ,   ___ &kp AT      &kp EXCL        &kp BSLH    ___         ___         ,
    ___ ___ &kp HASH    &kp LBKT    &kp RBKT    ___ ,   ___ &kp RGUI    &kp RALT        &kp RSHFT   &kp RCTRL   ___         ,
    ___ ___ &kp STAR    &kp CARET   &kp DLLR    ___ ,   ___ &kp COLON   &kp SEMICOLON   ___         ___         &tog RAISE  ,
                        ___         &kp ESC     ___ ,   ___ ___
)

ZMK_BASE_LAYER(Adjust,
    &studio_unlock  ___     ___     &kp C_BRI_UP    &kp C_VOL_UP    ___ ,   &bt BT_SEL 0    &bt BT_SEL 1    &bt BT_SEL 2    &bt BT_SEL 3    &out OUT_TOG    &bt BT_CLR  ,
    ___             ___     ___     LOCK_SCREEN     &kp C_MUTE      ___ ,   ___             &kp C_PREV      &kp C_PP        &kp C_NEXT      ___             ___         ,
    ___             ___     ___     &kp C_BRI_DN    &kp C_VOL_DN    ___ ,   ___             ___             ___             ___             ___             ___         ,
                                    ___             ___             ___ ,   ___             ___
)

ZMK_BASE_LAYER(Media,
    ___         ___     &kp C_PREV  &kp UP          &kp C_NEXT      ___ ,   ___     &kp C_PREV  &kp UP          &kp C_NEXT      ___     ___         ,
    ___         ___     &kp LEFT    &kp DOWN        &kp RIGHT       ___ ,   ___     &kp LEFT    &kp DOWN        &kp RIGHT       ___     ___         ,
    &tog MEDIA  ___     &kp C_MUTE  &kp C_VOL_DN    &kp C_VOL_UP    ___ ,   ___     &kp C_MUTE  &kp C_VOL_DN    &kp C_VOL_UP    ___     &tog MEDIA  ,
                                     ___            &kp C_PP        ___ ,   ___     &kp C_PP
)

/* make sure to update excluded-positions in charybdis_pointer.dtsi if you're modifying this layer */
/* note: K_CANCEL is not in those positions -- its intended not to be there. */
ZMK_BASE_LAYER(Mouse,
    ___         ___         ___         ___         ___             ___         ,   ___         ___         ___         ___         ___         ___         ,
    ___         &kp LCTRL   &kp LSHFT   &kp LALT    &kp LGUI        ___         ,   ___         &kp RGUI    &kp RALT    &kp RSHFT   &kp RCTRL   ___         ,
    &tog MOUSE  ___         &mkp MB5    &mkp RCLK   &mkp LCLK       &mkp MB4    ,   &mkp MB4    &mkp LCLK   &mkp RCLK   &mkp MB5    ___         &tog MOUSE  ,
                                        &mo SCROLL  &kp K_CANCEL    ___         ,   ___         &kp K_CANCEL
)

/* note: currently not being used */
ZMK_BASE_LAYER(Slow,
    ___         ___         ___         ___         ___             ___         ,   ___         ___         ___         ___         ___         ___         ,
    ___         &kp LCTRL   &kp LSHFT   &kp LALT    &kp LGUI        ___         ,   ___         &kp RGUI    &kp RALT    &kp RSHFT   &kp RCTRL   ___         ,
    &tog SLOW   ___         &mkp MB5    &mkp RCLK   &mkp LCLK       &mkp MB4    ,   &mkp MB4    &mkp LCLK   &mkp RCLK   &mkp MB5    ___         &tog SLOW   ,
                                        &mo SCROLL  &kp K_CANCEL    ___         ,   ___         &kp K_CANCEL
)

ZMK_BASE_LAYER(Scroll,
    ___         ___         ___         ___         ___             ___         ,   ___         ___         ___         ___         ___         ___         ,
    ___         &kp LCTRL   &kp LSHFT   &kp LALT    &kp LGUI        ___         ,   ___         &kp RGUI    &kp RALT    &kp RSHFT   &kp RCTRL   ___         ,
    &tog SCROLL ___         &mkp MB5    &mkp RCLK   &mkp LCLK       &mkp MB4    ,   &mkp MB4    &mkp LCLK   &mkp RCLK   &mkp MB5    ___         &tog SCROLL ,
                                        &mo SCROLL  &kp K_CANCEL    ___         ,   ___         &kp K_CANCEL
)
